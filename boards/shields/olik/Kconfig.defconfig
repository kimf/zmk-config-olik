## boards/shields/olik/Kconfig.defconfig
```kconfig
if SHIELD_OLIK_RIGHT

config ZMK_SPLIT_ROLE_CENTRAL
    default n

endif


if SHIELD_OLIK_LEFT

# Name must be less than 16 characters long!
config ZMK_KEYBOARD_NAME
    default "OLIK"

config ZMK_SPLIT_ROLE_CENTRAL
    default y

config ZMK_SPLIT_BLE_CENTRAL_PERIPHERALS
  default 1

config BT_MAX_CONN
  default 6

config BT_MAX_PAIRED
  default 6

endif


if SHIELD_OLIK_LEFT || SHIELD_OLIK_RIGHT

config ZMK_SPLIT
    default y
endif

# ---------------------
# Kconfig for shield "olik_left" with board "nice_nano_v2"
# ---------------------
if BOARD_NICE_NANO_V2 && SHIELD_OLIK_LEFT

config I2C
    default y

config ZMK_DISPLAY
    default y

if ZMK_DISPLAY

config I2C
    default y

config SSD1306
    default y

endif # ZMK_DISPLAY

if LVGL

config LV_Z_VDB_SIZE
    default 64

config LV_DPI_DEF
    default 148

config LV_Z_BITS_PER_PIXEL
    default 1

choice LV_COLOR_DEPTH
    default LV_COLOR_DEPTH_1
endchoice

endif # LVGL

endif
```

## boards/shields/olik/Kconfig.shield
```kconfig
config SHIELD_OLIK_LEFT
    def_bool $(shields_list_contains,olik_left)
  
config SHIELD_OLIK_RIGHT
    def_bool $(shields_list_contains,olik_right)
  
```

## config/west.yml
```yaml
manifest:
  defaults:
    revision: v0.3
  remotes:
    - name: zmkfirmware
      url-base: https://github.com/zmkfirmware
    - name: joelspadin
      url-base: https://github.com/joelspadin
    # Additional modules containing boards/shields/custom code can be listed here as well
    # See https://docs.zephyrproject.org/3.2.0/develop/west/manifest.html#projects
  projects:
    - name: zmk
      remote: zmkfirmware
      revision: v0.3.0
      import: app/west.yml
    - name: zmk-locales
      remote: joelspadin
      revision: main
    - name: zmk-overrides
      url: file:../zmk-overrides
  self:
    path: config
```

## zmk-overrides/Kconfig
```kconfig
menu "ZMK Olik Overrides"

config ZMK_WIDGET_PERIPHERAL_BATTERY_STATUS
    bool "Widget for peripheral battery charge information"
    depends on ZMK_SPLIT && ZMK_SPLIT_ROLE_CENTRAL
    depends on ZMK_SPLIT_BLE_CENTRAL_BATTERY_LEVEL_FETCHING
    select LV_USE_LABEL

endmenu
```
